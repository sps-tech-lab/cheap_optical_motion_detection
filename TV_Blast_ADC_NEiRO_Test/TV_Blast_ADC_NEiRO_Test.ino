#include "MsTimer2.h"

#define move_tresh 100        // гистерезис диффиринциала
#define brig_tresh 100        // гистерезис яркости

int   count;
int   data[4];                // данные АЦП
int   diff[4];                // величина изменения данных по каналам
int   move_nero_out;          // оценочный выход из нейросети "движение"
bool  move_nero_tre;          // логический выход из нейросети "движение"
int   i;                      // для циклов

//////////////////////////////////////  ИНИЦИАЛИЗАЦИЯ  /////////////////////////////////////////////////
void setup() {
  Serial.begin(9600);
  MsTimer2::set(1000, flash);         // 1000 ms  = 1 s
  // MsTimer2::start();               // Старт таймера
  pinMode(13, OUTPUT);
  digitalWrite(13, LOW);
}
//////////////////////////////////////  ОСНОВНОЙ ЦИКЛ  /////////////////////////////////////////////////
void loop()
{
  ADcacher();               // Считываем значения АЦП
  DataDiff_Save();          // Сохраняем первую выборку
  delay(100);
  ADcacher();               // Считываем значения АЦП    
  DataDiff_Calck();         // Вычесляем диффиренциал
  MoveNero();               // Оцениваем степерь "Движения"
  
  DataSend();               // Шлем данные на комп
  
  digitalWrite(13, LOW);
  if(move_nero_out>move_tresh)digitalWrite(13, HIGH);
}
//////////////////////////////////////  КОРРЕКТИРОВКА ДАННЫХ АЦП  //////////////////////////////////////
void cut()
{
  for(i=1; i<=4; i++)
  {
    if (data[i] == 255){ data[i] = 254; }
  }
}
//////////////////////////////////////  ЗАБИРАЕМ ДАННЫЕ ИЗ АЦП  ////////////////////////////////////////
void ADcacher()
{
  data[1] = analogRead(A0)>>2;
  data[2] = analogRead(A1)>>2;
  data[3] = analogRead(A2)>>2;
  data[4] = analogRead(A3)>>2;
  cut();
}
//////////////////////////////////////  ОТПРАВКА ДАННЫХ НА КОМП  ///////////////////////////////////////
void DataSend()
{
  Serial.print("####################");
  Serial.print('\n');
  Serial.print(move_nero_out);
  Serial.print('\n');
/*
  for(i=1; i<=4; i++)               // выводим дифиринциалы
  {
    Serial.print('\n');
    Serial.print(diff[i]);
  }
  Serial.print('\n');
*/
}
//////////////////////////////////////  СОХРАНИЕНИЕ ПЕРВОЙ ВЫБОРКИ  /////////////////////////////////////
void DataDiff_Save()
{
  for(i=1; i<=4; i++)
  {
    diff[i]=data[i];
  }
}
////////////////////////////////////// ВЫЧЕСЛЕНИЕ ДИФФИРИНЦИАЛА  ////////////////////////////////////////
void DataDiff_Calck()
{
  for(i=1; i<=4; i++)
  {
    if(diff[i]>data[i])
    {
      diff[i] = diff[i]-data[i];
    }else{
      diff[i] = data[i]-diff[i];
    }
  }
}
////////////////////////////////////// НЕЙРОСЕТЬ "ДВИЖЕНИЕ"  ///////////////////////////////////////////
void MoveNero()
{
  move_nero_out=0;               // Чистим выход
  for(i=1; i<=4; i++)            // Складываем диффиринциалы
  {
    move_nero_out+=diff[i];
  }
}
////////////////////////////////////// ВЫЗЫВАЕТСЯ РАЗ В СЕКУНДУ  ///////////////////////////////////////
void flash(void) 
{  
  // пока хз зачем (О_о)
} 
////////////////////////////////////// 

